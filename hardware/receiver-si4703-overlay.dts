/dts-v1/;
/plugin/;

/ {
	compatible = "brcm,bcm2711";

	fragment@0 {
		target = <&i2c1>;
		__overlay__ {
			status = "okay";

			fmradio@10 {
				compatible = "silabs,si470x";
				reg = <0x10>;
				interrupt-parent = <&gpio>;
				interrupts = <24 2>;
				reset-gpios = <&gpio 17 1>;
			};
		};
	};
};
